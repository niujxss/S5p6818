## drivers/clk/nexell/Kconfig
```kconfig
# SPDX-License-Identifier: GPL-2.0
config COMMON_CLK_S5PXX18
	bool "Nexell S5PXX18 (S5P6818) clock support"
	depends on ARCH_NEXELL || COMPILE_TEST
	default ARCH_NEXELL
```

## drivers/gpu/drm/nexell/Kconfig
```kconfig
# SPDX-License-Identifier: GPL-2.0
config DRM_NEXELL
	tristate "DRM support for Nexell S5P6818/S5P4418 SoCs (WIP)"
	depends on DRM && OF
	select DRM_CLIENT_SELECTION
	select DRM_GEM_DMA_HELPER
	select DRM_KMS_HELPER
	help
	  Atomic-KMS driver for the Nexell S5Pxx18 display controller (DPC/MLC)
	  and HDMI output. Work in progress: a single fixed-mode CRTC/plane that
	  reuses the pipeline the bootloader programmed. Provides /dev/dri/card0
	  and a framebuffer console on HDMI.
```

## drivers/pinctrl/nexell/Kconfig
```kconfig
# SPDX-License-Identifier: GPL-2.0
config PINCTRL_NEXELL
	bool
	select PINMUX
	select PINCONF
	select GENERIC_PINCONF

config PINCTRL_S5PXX18
	bool "Nexell S5PXX18 (S5P6818) pinctrl and GPIO driver"
	depends on (ARCH_NEXELL || COMPILE_TEST) && OF
	select PINCTRL_NEXELL
	default ARCH_NEXELL
```

## sound/soc/nexell/Kconfig
```kconfig
# SPDX-License-Identifier: GPL-2.0-only
config SND_SOC_NEXELL
	tristate "ASoC support for Nexell S5P6818/S5P4418 SoCs"
	depends on ARCH_NEXELL || COMPILE_TEST
	help
	  Say Y or M if you want to add support for codecs attached to the
	  Nexell S5Pxx18 I2S interface. You will also need to select the
	  audio interfaces to support below.

config SND_SOC_NEXELL_I2S
	tristate "Nexell S5P6818/S5P4418 I2S driver"
	depends on SND_SOC_NEXELL
	select SND_SOC_GENERIC_DMAENGINE_PCM
	help
	  Say Y or M if you want to add support for the I2S controller found
	  on Nexell S5P6818/S5P4418 SoCs (uses the PL080 DMA engine).

config SND_SOC_NEXELL_SPDIF
	tristate "Nexell S5P6818/S5P4418 S/PDIF-TX (HDMI audio) driver"
	depends on SND_SOC_NEXELL
	select SND_SOC_GENERIC_DMAENGINE_PCM
	help
	  Say Y or M for the S/PDIF transmitter, wired internally to the HDMI
	  controller - this is the audio source for HDMI audio.
```
